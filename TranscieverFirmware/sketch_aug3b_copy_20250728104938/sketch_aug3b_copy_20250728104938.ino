/////////////////////////////////////////////////////////////////////////////////////////////////////////////////
// Main firmware/configuration for the Heltec LoRa board as part of the LoRa based emergency communications MSc project
// b018567j@student.staffs.ac.uk / Matthew Boyce / 19018567 - Sep 2025.
/////////////////////////////////////////////////////////////////////////////////////////////////////////////////

#include <Wire.h>  
#include "HT_SSD1306Wire.h"
#include "LoRaWan_APP.h"
#include "Arduino.h"
#include <ArduinoJson.h>
#include <vector>


// =============================== ICONS ====================================
//Icons for the OLED display, in XBM format.

const unsigned char TXWARMUP [] PROGMEM = {
0x00, 0x00, 0x00, 0x00, 0x00, 0x00, 0x00, 0x00, 0x00, 0x00, 0x00, 0x00, 
  0x00, 0x00, 0x00, 0x00, 0x00, 0x00, 0x00, 0x00, 0x00, 0x00, 0x00, 0x00, 
  0x00, 0x00, 0x00, 0x00, 0x00, 0x00, 0x00, 0x00, 0x00, 0x00, 0x00, 0x00, 
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  0x00, 0x00, 0x00, 0x00, 0x00, 0x00, 0x00, 0x00, };

const unsigned char TXINPROG [] PROGMEM = {
0x00, 0x00, 0x00, 0x00, 0x00, 0x00, 0x00, 0x00, 0x00, 0x00, 0x00, 0x00, 
  0x00, 0x00, 0x00, 0x00, 0x00, 0x00, 0x00, 0x00, 0x00, 0x00, 0x00, 0x00, 
  0x00, 0x00, 0x00, 0x00, 0x00, 0x00, 0x00, 0x00, 0x00, 0x00, 0x00, 0x00, 
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  0x00, 0x00, 0x00, 0x00, 0x00, 0x00, 0x00, 0x00, };

const unsigned char TXLOCKOUT [] PROGMEM = {
0x00, 0x00, 0x00, 0x00, 0x00, 0x00, 0x00, 0x00, 0x00, 0x00, 0x00, 0x00, 
  0x00, 0x00, 0x00, 0x00, 0x00, 0x00, 0x00, 0x00, 0x00, 0x00, 0x00, 0x00, 
  0x00, 0x00, 0x00, 0x00, 0x00, 0x00, 0x00, 0x00, 0x00, 0x00, 0x00, 0x00, 
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  0x00, 0x00, 0x00, 0x00, 0x00, 0x00, 0x00, 0x00,};

const unsigned char TXERROR [] PROGMEM = {
0x00, 0x00, 0x00, 0x00, 0x00, 0x00, 0x00, 0x00, 0x00, 0x00, 0x00, 0x00, 
  0x00, 0x00, 0x00, 0x00, 0x00, 0x00, 0x00, 0x00, 0x00, 0x00, 0x00, 0x00, 
  0x00, 0x00, 0x00, 0x00, 0x00, 0x00, 0x00, 0x00, 0x00, 0x00, 0x00, 0x00, 
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  0x00, 0x00, 0x00, 0x00, 0x00, 0x00, 0x00, 0x00, };

const unsigned char CONFIGUPDATED [] PROGMEM = {
0x00, 0x00, 0x00, 0x00, 0x00, 0x00, 0x00, 0x00, 0x00, 0x00, 0x00, 0x00, 
  0x00, 0x00, 0x00, 0x00, 0x00, 0x00, 0x00, 0x00, 0x00, 0x00, 0x00, 0x00, 
  0x00, 0x00, 0x00, 0x00, 0x00, 0x00, 0x00, 0x00, 0x00, 0x00, 0x00, 0x00, 
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  0x00, 0x00, 0x00, 0x00, 0x00, 0x00, 0x00, 0x00, };

const unsigned char CONFIGERROR [] PROGMEM = {
0x00, 0x00, 0x00, 0x00, 0x00, 0x00, 0x00, 0x00, 0x00, 0x00, 0x00, 0x00, 
  0x00, 0x00, 0x00, 0x00, 0x00, 0x00, 0x00, 0x00, 0x00, 0x00, 0x00, 0x00, 
  0x00, 0x00, 0x00, 0x00, 0x00, 0x00, 0x00, 0x00, 0x00, 0x00, 0x00, 0x00, 
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  0x00, 0x00, 0x00, 0x00, 0x00, 0x00, 0x00, 0x00, };

const unsigned char TXCOMPLETE [] PROGMEM = {
 0x00, 0x00, 0x00, 0x00, 0x00, 0x00, 0x00, 0x00, 0x00, 0x00, 0x00, 0x00, 
  0x00, 0x00, 0x00, 0x00, 0x00, 0x00, 0x00, 0x00, 0x00, 0x00, 0x00, 0x00, 
  0x00, 0x00, 0x00, 0x00, 0x00, 0x00, 0x00, 0x00, 0x00, 0x00, 0x00, 0x00, 
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  0x00, 0x00, 0x00, 0x00, 0x00, 0x00, 0x00, 0x00, };


// 'RX-ALT', 16x16px
const unsigned char ICNRX [] PROGMEM = {
	0x00, 0x00, 0x00, 0x00, 0x00, 0x00, 0x00, 0x00, 0x00, 0x00, 0x3c, 0x21, 0x44, 0x12, 0x44, 0x08, 
	0x3c, 0x04, 0x24, 0x12, 0x44, 0x21, 0x00, 0x00, 0x00, 0x00, 0x00, 0x00, 0x00, 0x00, 0x00, 0x00
};
// 'RX', 16x16px
const unsigned char ICNLORA_INIT [] PROGMEM = {
	0x00, 0x00, 0x00, 0x00, 0x7c, 0x00, 0x38, 0x00, 0x10, 0x00, 0x10, 0x10, 0x10, 0x10, 0x10, 0x10, 
	0x10, 0x14, 0x10, 0x14, 0x10, 0x15, 0x10, 0x15, 0x50, 0x15, 0x50, 0x15, 0x00, 0x00, 0x00, 0x00
};
// 'TX-DISABLED', 16x16px
const unsigned char ICNLORA_FAIL [] PROGMEM = {
	0x00, 0x00, 0x00, 0x00, 0x7c, 0x00, 0x38, 0x00, 0x10, 0x00, 0x10, 0x00, 0x10, 0x00, 0x90, 0x20, 
	0x10, 0x11, 0x10, 0x0a, 0x10, 0x04, 0x10, 0x0a, 0x10, 0x11, 0x90, 0x20, 0x00, 0x00, 0x00, 0x00
};
// 'usb', 16x16px
const unsigned char ICNUSB [] PROGMEM = {
	0xa8, 0x0d, 0xa8, 0x14, 0xa8, 0x0d, 0x28, 0x15, 0xb8, 0x0d, 0x00, 0x00, 0xbf, 0xff, 0xa1, 0x80, 
	0xbf, 0x80, 0xa1, 0x80, 0xa1, 0xff, 0x2d, 0x08, 0x21, 0x08, 0x3f, 0x77, 0x00, 0x00, 0x00, 0x00
};
// 'TXLO', 16x16px
const unsigned char ICNTXLO [] PROGMEM = {
	0x00, 0x00, 0x00, 0x00, 0xc0, 0x03, 0x20, 0x04, 0x20, 0x04, 0x20, 0x04, 0xfc, 0x3f, 0x04, 0x20, 
	0x74, 0x29, 0x24, 0x24, 0x24, 0x22, 0x24, 0x29, 0x04, 0x20, 0xfc, 0x3f, 0x00, 0x00, 0x00, 0x00
};
// 'MSG_RX', 16x16px
const unsigned char ICNMSG_RX [] PROGMEM = {
	0x00, 0x00, 0x00, 0x08, 0x00, 0x08, 0x00, 0x2a, 0x00, 0x1c, 0x00, 0x08, 0x00, 0x00, 0xfc, 0x3f, 
	0x1c, 0x38, 0x64, 0x26, 0x84, 0x21, 0x04, 0x20, 0x04, 0x20, 0xfc, 0x3f, 0x00, 0x00, 0x00, 0x00
};
// 'MSG_TX', 16x16px
const unsigned char ICNMSG_TX [] PROGMEM = {
	0x00, 0x00, 0x10, 0x00, 0x38, 0x00, 0x54, 0x00, 0x10, 0x00, 0x10, 0x00, 0x00, 0x00, 0xfc, 0x3f, 
	0x1c, 0x38, 0x64, 0x26, 0x84, 0x21, 0x04, 0x20, 0x04, 0x20, 0xfc, 0x3f, 0x00, 0x00, 0x00, 0x00
};
// 'MSG_TXRX', 16x16px
const unsigned char ICNMSG_TXRX [] PROGMEM = {
	0x00, 0x00, 0x10, 0x08, 0x38, 0x08, 0x54, 0x2a, 0x10, 0x1c, 0x10, 0x08, 0x00, 0x00, 0xfc, 0x3f, 
	0x1c, 0x38, 0x64, 0x26, 0x84, 0x21, 0x04, 0x20, 0x04, 0x20, 0xfc, 0x3f, 0x00, 0x00, 0x00, 0x00
};
const unsigned char ICNBLANK [] PROGMEM = {
  0x00, 0x00, 0x00, 0x00, 0x00, 0x00, 0x00, 0x00, 0x00, 0x00, 0x00, 0x00, 0x00, 0x00, 0x00, 0x00,
  0x00, 0x00, 0x00, 0x00, 0x00, 0x00, 0x00, 0x00, 0x00, 0x00, 0x00, 0x00, 0x00, 0x00, 0x00, 0x00
};
// 'MSG', 16x16px
const unsigned char ICNMSG [] PROGMEM = {
	0x00, 0x00, 0x00, 0x00, 0x00, 0x00, 0x00, 0x00, 0x00, 0x00, 0x00, 0x00, 0x00, 0x00, 0xfc, 0x3f, 
	0x1c, 0x38, 0x64, 0x26, 0x84, 0x21, 0x04, 0x20, 0x04, 0x20, 0xfc, 0x3f, 0x00, 0x00, 0x00, 0x00
};
// 'DICT', 16x16px
const unsigned char ICNDICT [] PROGMEM = {
	0x00, 0x00, 0x00, 0x00, 0x7c, 0x7c, 0x84, 0x43, 0x34, 0x59, 0x04, 0x41, 0x34, 0x59, 0x04, 0x41, 
	0x34, 0x59, 0x04, 0x41, 0x34, 0x59, 0x04, 0x41, 0x7c, 0x7d, 0x80, 0x03, 0x00, 0x00, 0x00, 0x00
};
// 'ENC_ENABLED', 16x16px
const unsigned char ICNENC_ENABLED [] PROGMEM = {
	0x00, 0x00, 0x00, 0x00, 0xc0, 0x03, 0x20, 0x04, 0x20, 0x04, 0x20, 0x04, 0xfc, 0x3f, 0x0c, 0x30, 
	0x14, 0x28, 0x24, 0x24, 0x44, 0x22, 0x84, 0x21, 0x04, 0x20, 0xfc, 0x3f, 0x00, 0x00, 0x00, 0x00
};
// 'SF12', 16x16px
const unsigned char ICNSF12 [] PROGMEM = {
	0x00, 0x00, 0x00, 0x00, 0xfc, 0x3f, 0x04, 0x20, 0x24, 0x2f, 0x24, 0x28, 0x24, 0x28, 0x24, 0x28, 
	0x24, 0x2f, 0x24, 0x21, 0x24, 0x21, 0x24, 0x2f, 0x04, 0x20, 0xfc, 0x3f, 0x00, 0x00, 0x00, 0x00
};
// 'SF5', 16x16px
const unsigned char ICNSF5 [] PROGMEM = {
	0x00, 0x00, 0x00, 0x00, 0xfc, 0x3f, 0x04, 0x20, 0xe4, 0x27, 0x24, 0x20, 0x24, 0x20, 0xe4, 0x27, 
	0x04, 0x24, 0x04, 0x24, 0x04, 0x24, 0xe4, 0x27, 0x04, 0x20, 0xfc, 0x3f, 0x00, 0x00, 0x00, 0x00
};
// 'SF7', 16x16px
const unsigned char ICNSF7 [] PROGMEM = {
	0x00, 0x00, 0x00, 0x00, 0xfc, 0x3f, 0x04, 0x20, 0xf4, 0x2f, 0x04, 0x28, 0x04, 0x2c, 0x04, 0x26, 
	0x04, 0x23, 0x84, 0x21, 0x84, 0x20, 0x84, 0x20, 0x04, 0x20, 0xfc, 0x3f, 0x00, 0x00, 0x00, 0x00
};
// 'SF9', 16x16px
const unsigned char ICNSF9 [] PROGMEM = {
	0x00, 0x00, 0x00, 0x00, 0xfc, 0x3f, 0x04, 0x20, 0xc4, 0x21, 0x24, 0x22, 0x24, 0x22, 0x24, 0x22, 
	0xc4, 0x23, 0x04, 0x22, 0x24, 0x22, 0xc4, 0x21, 0x04, 0x20, 0xfc, 0x3f, 0x00, 0x00, 0x00, 0x00
};
// 'TXPWR-HI', 16x16px
const unsigned char ICNTXPWR_HI [] PROGMEM = {
	0x00, 0x00, 0x00, 0x00, 0x00, 0x00, 0x00, 0x00, 0x20, 0x00, 0x10, 0x10, 0x08, 0x10, 0x0c, 0x14, 
	0x7e, 0x14, 0x30, 0x15, 0x18, 0x15, 0x08, 0x00, 0x44, 0x55, 0x00, 0x00, 0x00, 0x00, 0x00, 0x00
};
// 'TXPWR-LO', 16x16px
const unsigned char ICNTXPWR_LO [] PROGMEM = {
	0x00, 0x00, 0x00, 0x00, 0x00, 0x00, 0x00, 0x00, 0x20, 0x00, 0x10, 0x00, 0x08, 0x00, 0x0c, 0x00, 
	0x7e, 0x00, 0x30, 0x01, 0x18, 0x01, 0x08, 0x00, 0x44, 0x55, 0x00, 0x00, 0x00, 0x00, 0x00, 0x00
};
// 'TXPWR-MAX', 16x16px
const unsigned char ICNTXPWR_MAX [] PROGMEM = {
	0x00, 0x00, 0x00, 0x00, 0x00, 0x00, 0x00, 0x40, 0x20, 0x40, 0x10, 0x50, 0x08, 0x50, 0x0c, 0x54, 
	0x7e, 0x54, 0x30, 0x55, 0x18, 0x55, 0x08, 0x00, 0x44, 0x55, 0x00, 0x00, 0x00, 0x00, 0x00, 0x00
};
// 'TXPWR-MED', 16x16px
const unsigned char ICNTXPWR_MED [] PROGMEM = {
	0x00, 0x00, 0x00, 0x00, 0x00, 0x00, 0x00, 0x00, 0x20, 0x00, 0x10, 0x00, 0x08, 0x00, 0x0c, 0x04, 
	0x7e, 0x04, 0x30, 0x05, 0x18, 0x05, 0x08, 0x00, 0x44, 0x55, 0x00, 0x00, 0x00, 0x00, 0x00, 0x00
};
// 'TXPWR-ZERO', 16x16px
const unsigned char ICNTXPWR_ZERO [] PROGMEM = {
	0x00, 0x00, 0x00, 0x00, 0x00, 0x00, 0x00, 0x00, 0x20, 0x00, 0x10, 0x00, 0x08, 0x00, 0x0c, 0x00, 
	0x7e, 0x00, 0x30, 0x00, 0x18, 0x00, 0x08, 0x00, 0x44, 0x55, 0x00, 0x00, 0x00, 0x00, 0x00, 0x00
};

//Struct for RxMessage entities
struct RxMessage {
  String messagePayload;        //Received raw byte payload
  uint16_t messageSize;         //Size of message received
  int16_t messageRssi;          //RSSI of received message
  int8_t messageSnr;            //SNR of received message


  //Constructor
  RxMessage(String payload, uint16_t size, int16_t rssi, int8_t snr) : messagePayload(payload), messageSize(size), messageRssi(rssi), messageSnr(snr) {}
};



//Struct for TxMessage entities
struct TxMessage {
  String messageType;           //Currently unused
  String messagePayload;        //Payload (raw bytes) to be sent
};



//Struct for global Sx1262/LORA Config
struct sysGlobalConfig {
  //Xceiver Frequency
  uint32_t RF_FREQUENCY = 868600000;
  //Invert IQ for TX
  int RF_IQ_INVERSION = 0;
  //Output power in dBm
  int TX_OUTPUT_POWER = 1;
  //LoRa Bandwidth
  int LORA_BANDWIDTH = 0;
  //LoRa Spreading Factor (SF)
  int LORA_SPREADING_FACTOR = 7;
  //LoRa Coding Rate
  int LORA_CODINGRATE = 1;
  //Preamble Length
  int LORA_PREAMBLE_LENGTH = 8;
  //Symbol Timeout
  int LORA_SYMBOL_TIMEOUT = 0;
  //Fixed payload lengths
  bool LORA_FIX_LENGTH_PAYLOAD_ON = false;
  //Invert IQ
  bool LORA_IQ_INVERSION_ON = false;
  //RX Symbol timeout
  int RX_SYM_TIMEOUT = 8;
  //RX fixed length packets
  int RX_FIXED_LENGTH_PACKETS = 0;
  //If fixed length, how long?
  int RX_FIXED_PAYLOAD_LENGTH = 0;
  //Enable CRC for RX
  int RX_CRC_ENABLED = 1;
  //Intra packet-freq hopping
  int RX_INTRA_PACKET_FREQ_HOP_ENABLED = 0;
  //Hop period in symbols, if enabled
  int RX_INTRA_PACKET_HOP_PERIOD = 0;
  //Invert IQ on RX
  int RX_IQ_INVERSION = 0;
  //Continuous RX mode
  bool RX_RECEP_CONT = true;
  // Rx CAD/CS monitoring window
  uint32_t RX_CS_MS = 50;
};



//Global Config used in initial LoRa configuration - Uses default values from struct
sysGlobalConfig globalConfig;

//Buffer size for incoming messages
#define BUFFER_SIZE 256


//Firmware init parameters
bool INIT_LORA_MODULE = true; // Load LoRa Radio
bool LORA_TX_LOCKOUT = false;  // Disable TX
bool DEBUG_MODE = true;       // Enable Debug mode (Additional verbosity in serial link, may break desktop app)

//Icon X/Y locations on screen
struct IconLocations{
  //USB Connected Indicator
  const int USB_X = 2;
  const int USB_Y = 2;

  //TX Lockout Indicator
  const int TXLO_X = 94;
  const int TXLO_Y = 2;

  //LORA Init Indicator
  const int LORA_STATUS_X = 111;
  const int LORA_STATUS_Y = 2;

  //Traffic Indicator
  const int TRAFF_X = 19;
  const int TRAFF_Y = 2;

  //Uplink and downlink arrows
  const int TRAFF_UPL_X = 23;
  const int TRAFF_UPL_Y = 7;

  const int TRAFF_DLK_X = 30;
  const int TRAFF_DLK_Y = 7;

  //Dictionary Indicator
  const int DICT_IND_X = 36;
  const int DICT_IND_Y = 2;

  //Encryption Indicator
  const int ENC_MSG_IND_X = 53;
  const int ENC_MSG_IND_Y = 2;

  //TXPWR Indicator
  const int TX_PWR_X = 53;
  const int TX_PWR_Y = 2;

  //SF Display
  const int SF_IND_X = 70;
  const int SF_IND_Y = 2;

  //Freq Display
  const int FREQ_DISPLAY_X = 128;
  const int FREQ_DISPLAY_Y = 43;
};

IconLocations IconLocations;

//Message Queues
//Tx
std::vector<TxMessage> TxMessageBuffer;
//Rx
std::vector<RxMessage> RxMessageBuffer;

//Debug function for testing RX buffer - Appends two test messages to buffer
void debugRxMessageBuffer(){
  RxMessageBuffer.emplace_back("2A3B4CFF", 7, -39, 12);
  RxMessageBuffer.emplace_back("2A3B4CFE", 7, -38, 13);
}

//Display Configuration
static SSD1306Wire  display(0x3c, 500000, SDA_OLED, SCL_OLED, GEOMETRY_128_64, RST_OLED);

//RxDone params
int16_t rssi,rxSize;
char txpacket[BUFFER_SIZE];
char rxpacket[BUFFER_SIZE];

//Callback function for TxDone
void TxDoneCallback(){

}

//Callback function for Txtimeout
void TxTimeoutCallback(){

}

//Callback function for RxDone
void RxDoneCallback(uint8_t* payload, uint16_t size, int16_t rssi, int8_t snr){
  
  //Display the downlink arrow
  DisplayDownlinkArrow(true);

  //Copy received data
  memcpy(rxpacket, payload, size );
  rxpacket[size]='\0';
  Radio.Sleep( );

  //Assemble raw LoRa bytes to hex
  String hexPayload = "";

  //Iterate over received data
  for (int i = 0; i < size; i++){ 
    if (payload[i] < 0x10) hexPayload += "0";
    hexPayload += String(payload[i], HEX);
  }

  hexPayload.toUpperCase();

  //Append message to RxBuffer
  RxMessageBuffer.emplace_back(hexPayload, size, rssi, snr);

  //Hide downlink arrow
  DisplayDownlinkArrow(false);
}

//Callback function for RxTimeout
void RxTimeoutCallback(){

}

//Callback function for RxError
void RxErrorCallback(){

}

//Callback function for IPFH Channel change 
void FhssChangeChannelCallback(uint8_t currentChannel){

}

//Callback for CAD
void CadDone(bool channelActivityDetected){
  Serial.println(channelActivityDetected);

}

//Callback definitions for radio driver
RadioEvents_t RadioEvents = {
  .TxDone = TxDoneCallback,
  .TxTimeout = TxTimeoutCallback,
  .RxDone = RxDoneCallback,
  .RxTimeout = RxTimeoutCallback,
  .RxError = RxErrorCallback,
  .FhssChangeChannel = FhssChangeChannelCallback,
  .CadDone = CadDone
};

//Method to check to see if channel is free
bool EstablishChannelState(uint32_t csduration){
  
  //Display TX Warmup message
  DisplayStatusSymbol("TXWARMUP", 500);
  
  //Get current average RSSI over 1sec
  int16_t currentRssi;
  Radio.RxBoosted(0);
  for (int i=0; i<= 4; i++){
    delay(100);
    currentRssi += Radio.Rssi(MODEM_LORA);
  }
  Radio.Sleep();

  //Average
  currentRssi = (currentRssi/5);

  //Configure threshold for transmission - Add squelch
  int16_t threshold = currentRssi + 5;

  //Begin CAD & Return status
  bool channelFree = Radio.IsChannelFree(MODEM_LORA, globalConfig.RF_FREQUENCY, threshold, globalConfig.RX_CS_MS);
  return channelFree;
}

//Method to handle incoming message to transmit
void ParseTxMessage(String payload){
  //New struct object
  TxMessage msg;

  //Placeholder
  msg.messageType = "USB";
  msg.messagePayload = payload;

  //Queue
  AddTxMessageToQueue(msg);
}

//Method to add TxMessage to Tx Queue
void AddTxMessageToQueue(TxMessage message){
  //Assemble temporary TxMessage struct
  TxMessage msg;
  msg.messageType = message.messageType;
  msg.messagePayload = message.messagePayload;

  //Write to Tx buffer
  TxMessageBuffer.emplace_back(msg);
}

//Method to retrieve latest message from queue
TxMessage DequeueTxMessage(){
  //Get message from queue
  TxMessage msg = TxMessageBuffer.front();

  //Remove
  TxMessageBuffer.erase(TxMessageBuffer.begin());

  //Return
  return msg;
}

//Method to process TxQueue
void ProcessTxQueue(){
  //Check to see if LORA_TX_LOCKOUT is enabled
  if(!LORA_TX_LOCKOUT){

    //Iterate through buffer
    for (const auto & msg : TxMessageBuffer){

      //Retrieve message from queue
      TxMessage messageToSend = DequeueTxMessage();

      //Attempt transmission
      bool result = TransmitMessage(messageToSend);
      if(!result){
        DisplayStatusSymbol("TXERROR", 1000);
      }
      delay(100);
    }
  } else {
    //Notify lockout status
    DisplayStatusSymbol("TXLOCKOUT", 5000);
  }
}

//Method to convert Hex to byte for transmitting
std::vector<uint8_t> HexToBytes(const String &hex) {
  //Create byte list
  std::vector<uint8_t> bytes;

  //Allocate mem
  bytes.reserve(hex.length() / 2);

  //Iterate through string in 2-char chunks
  for (size_t i = 0; i < hex.length(); i += 2) {
      char c1 = hex[i];
      char c2 = hex[i + 1];

      //2 chars + null terminator
      char byteStr[3] = { c1, c2, '\0' };

      //Convert byte to int
      uint8_t byte = (uint8_t) strtol(byteStr, nullptr, 16);

      //Add to initial array
      bytes.push_back(byte);
  }

  //Return byte list
  return bytes;
}

//Method to transmit message object
bool TransmitMessage(TxMessage message){
  //Verify lockout status
  if (LORA_TX_LOCKOUT){
    return false;
  }

  delay(100);
  //Attempt a transmission 3 times
  for (int attempt = 0 ; attempt <= 3; attempt++){
    //Perform CAD
    if (EstablishChannelState(50)){
      delay(100);
      //Display message + uplink symbol
      DisplayStatusSymbol("TXINPROG", 2500);
      DisplayUplinkArrow(true);
      delay(1000);
      //Enable TX LED
      TxLED(true);
      delay(50);
      //Add additional padding if the message is odd-length
      if(message.messagePayload.length() % 2 != 0){
        message.messagePayload += "0";
      }

      //Convert to bytes
      std::vector<uint8_t> payload = HexToBytes(message.messagePayload);

      //Transmit
      Radio.Send(payload.data(), payload.size());
      Radio.IrqProcess();

      //Cool-down
      delay(50);
      TxLED(false);
      return true;
    } else {
      //CAD found traffic, random back-off
      delay(random(0,250));
    }
  }

  return false;
}

//Debug method to iteratively print TxQueue to screen
void DebugTxQueue(){
  ClearFreqDisplay();
  display.setFont(ArialMT_Plain_10);
  for (const auto& msg : TxMessageBuffer){
    display.drawString(32, 23, msg.messageType);
    display.drawString(32, 33, msg.messagePayload);
    display.display();
    delay(1000);
    ClearFreqDisplay();
  }
  delay(100);
}

//Method to sequentially iterate through RxMessage queue and pass them back over serial
void ReturnRxMessages(){
  //If queue isn't empty - Get latest message from front of queue
  if (!RxMessageBuffer.empty()){
    RxMessage msg = RxMessageBuffer.front();

    //Remove from buffer
    RxMessageBuffer.erase(RxMessageBuffer.begin());

    //Create temporary doc
    DynamicJsonDocument latestRxMessage(512);
    latestRxMessage["statementType"] = "RxNewMessage";

    //Assemble payload
    JsonObject payload = latestRxMessage.createNestedObject("statementPayload");
    payload["messagePayload"] = msg.messagePayload;
    payload["messageSize"] = msg.messageSize;
    payload["messageRssi"] = msg.messageRssi;
    payload["messageSnr"] = msg.messageSnr;

    //Pass back to handler
    Serial.println(serializeJson(latestRxMessage, Serial));

  } else {
    ReturnGeneralError("No Messages");
  }
}    

//Method to parse incoming GlobalConfigurationUpdate
sysGlobalConfig ParseNewGlobalConfig(JsonObject cfg){
  sysGlobalConfig newGlobalConfig;
  newGlobalConfig.RF_FREQUENCY = cfg["RF_FREQUENCY"];
  newGlobalConfig.RF_IQ_INVERSION = cfg["RF_IQ_INVERSION"];
  newGlobalConfig.TX_OUTPUT_POWER = cfg["TX_OUTPUT_POWER"];
  newGlobalConfig.LORA_BANDWIDTH = cfg["LORA_BANDWIDTH"];
  newGlobalConfig.LORA_SPREADING_FACTOR = cfg["LORA_SPREADING_FACTOR"];
  newGlobalConfig.LORA_CODINGRATE = cfg["LORA_CODINGRATE"];
  newGlobalConfig.LORA_PREAMBLE_LENGTH = cfg["LORA_PREAMBLE_LENGTH"];
  newGlobalConfig.LORA_SYMBOL_TIMEOUT = cfg["LORA_SYMBOL_TIMEOUT"];
  newGlobalConfig.LORA_FIX_LENGTH_PAYLOAD_ON = cfg["LORA_FIX_LENGTH_PAYLOAD_ON"];
  newGlobalConfig.LORA_IQ_INVERSION_ON = cfg["LORA_IQ_INVERSION_ON"];
  newGlobalConfig.RX_SYM_TIMEOUT = cfg["RX_SYM_TIMEOUT"];
  newGlobalConfig.RX_FIXED_LENGTH_PACKETS = cfg["RX_FIXED_LENGTH_PACKETS"];
  newGlobalConfig.RX_FIXED_PAYLOAD_LENGTH = cfg["RX_FIXED_PAYLOAD_LENGTH"];
  newGlobalConfig.RX_CRC_ENABLED = cfg["RX_CRC_ENABLED"];
  newGlobalConfig.RX_INTRA_PACKET_FREQ_HOP_ENABLED = cfg["RX_INTRA_PACKET_FREQ_HOP_ENABLED"];
  newGlobalConfig.RX_INTRA_PACKET_HOP_PERIOD = cfg["RX_INTRA_PACKET_HOP_PERIOD"];
  newGlobalConfig.RX_IQ_INVERSION = cfg["RX_IQ_INVERSION"];
  newGlobalConfig.RX_RECEP_CONT = cfg["RX_RECEP_CONT"];
  newGlobalConfig.RX_CS_MS = cfg["RX_CS_MS"];

  return newGlobalConfig;
}

//Method to update Global Configuration based on received sysGlobalConfig
bool UpdateGlobalConfig(sysGlobalConfig cfg){
  //DEBUG
  ClearFreqDisplay();
  display.setFont(ArialMT_Plain_10);



  ClearFreqDisplay();
  display.drawStringMaxWidth((20), (23), 128, "PARAM: RFQ ");
  display.display();
  //TX PARAMETER CHECK
  if (Radio.CheckRfFrequency(cfg.RF_FREQUENCY)){
    //Frequency Acceptable
    globalConfig.RF_FREQUENCY = cfg.RF_FREQUENCY;
  } else {
    //Invalid frequency passed - Use Default
    globalConfig.RF_FREQUENCY = 860000000;
  }

  ClearFreqDisplay();
  display.drawStringMaxWidth((20), (23), 128, "PARAM: IQI ");
  display.display();
  if (cfg.RF_IQ_INVERSION == 0 || cfg.RF_IQ_INVERSION == 1){
    globalConfig.RF_IQ_INVERSION = cfg.RF_IQ_INVERSION;
  }
  ClearFreqDisplay();
  display.drawStringMaxWidth((20), (23), 128, "PARAM: PWR ");
  display.display();
  if(cfg.TX_OUTPUT_POWER >= -9 && cfg.TX_OUTPUT_POWER <= 14){
    //Power acceptable
    globalConfig.TX_OUTPUT_POWER = cfg.TX_OUTPUT_POWER;
  }
  ClearFreqDisplay();
  display.drawStringMaxWidth((20), (23), 128, "PARAM: LBW ");
  display.display();
  if(cfg.LORA_BANDWIDTH == 0 || cfg.LORA_BANDWIDTH == 1 || cfg.LORA_BANDWIDTH == 2){
    //Bandwidth acceptable
    globalConfig.LORA_BANDWIDTH = cfg.LORA_BANDWIDTH;
  }
  ClearFreqDisplay();
  display.drawStringMaxWidth((20), (23), 128, "PARAM: SFC");
  display.display();
  if(cfg.LORA_SPREADING_FACTOR == 5 || cfg.LORA_SPREADING_FACTOR == 7 || cfg.LORA_SPREADING_FACTOR == 9 || cfg.LORA_SPREADING_FACTOR == 12){
    //SF Acceptable
    globalConfig.LORA_SPREADING_FACTOR = cfg.LORA_SPREADING_FACTOR;
  }
  ClearFreqDisplay();
  display.drawStringMaxWidth((20), (23), 128, "PARAM: CDR ");
  display.display();
  if(cfg.LORA_CODINGRATE >= 1 && cfg.LORA_CODINGRATE <=4 ){
    //Acceptable CR
    globalConfig.LORA_CODINGRATE = cfg.LORA_CODINGRATE;
  }
  ClearFreqDisplay();
  display.drawStringMaxWidth((20), (23), 128, "PARAM: PRE ");
  display.display();
  if(cfg.LORA_PREAMBLE_LENGTH >= 0 && cfg.LORA_PREAMBLE_LENGTH <= 32){
    //PREL Acceptable
    globalConfig.LORA_PREAMBLE_LENGTH = cfg.LORA_PREAMBLE_LENGTH;
  }
  ClearFreqDisplay();
  display.drawStringMaxWidth((20), (23), 128, "PARAM: SMT ");
  display.display();
  if(cfg.LORA_SYMBOL_TIMEOUT >= 0){
    globalConfig.LORA_SYMBOL_TIMEOUT = cfg.LORA_SYMBOL_TIMEOUT;
  }
  ClearFreqDisplay();
  display.drawStringMaxWidth((20), (23), 128, "PARAM: FLP ");
  display.display();
  globalConfig.LORA_FIX_LENGTH_PAYLOAD_ON = cfg.LORA_FIX_LENGTH_PAYLOAD_ON; //Bool
  ClearFreqDisplay();
  display.drawStringMaxWidth((20), (23), 128, "PARAM: IQI2 ");
  display.display();
  globalConfig.LORA_IQ_INVERSION_ON = cfg.LORA_IQ_INVERSION_ON; //Bool
  
  ClearFreqDisplay();
  display.drawStringMaxWidth((20), (23), 128, "PARAM: RST ");
  display.display();
  //RxSymbolTimeout check
  if(cfg.RX_SYM_TIMEOUT >= 0 && cfg.RX_SYM_TIMEOUT <= 32){
    //RXSymbolTimeout Acceptable
    globalConfig.RX_SYM_TIMEOUT = cfg.RX_SYM_TIMEOUT;
  }
  ClearFreqDisplay();
  display.drawStringMaxWidth((20), (23), 128, "PARAM: RFP ");
  display.display();
  if(cfg.RX_FIXED_LENGTH_PACKETS == 1 || cfg.RX_FIXED_LENGTH_PACKETS == 0){
    //FLP Acceptable
    globalConfig.RX_FIXED_LENGTH_PACKETS = cfg.RX_FIXED_LENGTH_PACKETS;
  }
  ClearFreqDisplay();
  display.drawStringMaxWidth((20), (23), 128, "PARAM: FPL ");
  display.display();
  if(cfg.RX_FIXED_PAYLOAD_LENGTH >= 0 && cfg.RX_FIXED_PAYLOAD_LENGTH <= 250){
    //Fixed payload length acceptable
    globalConfig.RX_FIXED_PAYLOAD_LENGTH = cfg.RX_FIXED_PAYLOAD_LENGTH;
  }
  ClearFreqDisplay();
  display.drawStringMaxWidth((20), (23), 128, "PARAM: RCC ");
  display.display();
  if(cfg.RX_CRC_ENABLED == 1 || cfg.RX_CRC_ENABLED == 0){
    //Crc state acceptable
    globalConfig.RX_CRC_ENABLED = cfg.RX_CRC_ENABLED;
  }
  ClearFreqDisplay();
  display.drawStringMaxWidth((20), (23), 128, "PARAM: IPFH ");
  display.display();
  if(cfg.RX_INTRA_PACKET_FREQ_HOP_ENABLED == 1 || cfg.RX_INTRA_PACKET_FREQ_HOP_ENABLED == 0){
    globalConfig.RX_INTRA_PACKET_FREQ_HOP_ENABLED = cfg.RX_INTRA_PACKET_FREQ_HOP_ENABLED;
  }
  ClearFreqDisplay();
  display.drawStringMaxWidth((20), (23), 128, "PARAM: IPHP ");
  display.display();
  if(cfg.RX_INTRA_PACKET_HOP_PERIOD >= 0 && cfg.RX_INTRA_PACKET_HOP_PERIOD <= 32){
    globalConfig.RX_INTRA_PACKET_HOP_PERIOD = cfg.RX_INTRA_PACKET_HOP_PERIOD;
  }
  ClearFreqDisplay();
  display.drawStringMaxWidth((20), (23), 128, "PARAM: RXIQ ");
  display.display();
  if(cfg.RX_IQ_INVERSION == 1 || cfg.RX_IQ_INVERSION == 0){
    globalConfig.RX_IQ_INVERSION == cfg.RX_IQ_INVERSION;
  }
  ClearFreqDisplay();
  display.drawStringMaxWidth((20), (23), 128, "PARAM: RRC ");
  display.display();
  globalConfig.RX_RECEP_CONT = cfg.RX_RECEP_CONT;


  globalConfig.RX_CS_MS = cfg.RX_CS_MS;
  
  
  return true;
}

//Method to handle the return of the current Global configuration
void SendGlobalConfig(){
  StaticJsonDocument<512> globalConfigDoc;
  globalConfigDoc["statementType"] = "globalConfigurationStatus";
  globalConfigDoc["statementPayload"]["RF_FREQUENCY"] = globalConfig.RF_FREQUENCY;
  globalConfigDoc["statementPayload"]["RF_IQ_INVERSION"] = globalConfig.RF_IQ_INVERSION;
  globalConfigDoc["statementPayload"]["TX_OUTPUT_POWER"] = globalConfig.TX_OUTPUT_POWER;
  globalConfigDoc["statementPayload"]["LORA_BANDWIDTH"] = globalConfig.LORA_BANDWIDTH;
  globalConfigDoc["statementPayload"]["LORA_SPREADING_FACTOR"] = globalConfig.LORA_SPREADING_FACTOR;
  globalConfigDoc["statementPayload"]["LORA_CODINGRATE"] = globalConfig.LORA_CODINGRATE;
  globalConfigDoc["statementPayload"]["LORA_PREAMBLE_LENGTH"] = globalConfig.LORA_PREAMBLE_LENGTH;
  globalConfigDoc["statementPayload"]["LORA_SYMBOL_TIMEOUT"] = globalConfig.LORA_SYMBOL_TIMEOUT;
  globalConfigDoc["statementPayload"]["LORA_FIX_LENGTH_PAYLOAD_ON"] = globalConfig.LORA_FIX_LENGTH_PAYLOAD_ON;
  globalConfigDoc["statementPayload"]["LORA_IQ_INVERSION_ON"] = globalConfig.LORA_IQ_INVERSION_ON;
  globalConfigDoc["statementPayload"]["RX_SYM_TIMEOUT"] = globalConfig.RX_SYM_TIMEOUT;
  globalConfigDoc["statementPayload"]["RX_FIXED_LENGTH_PACKETS"] = globalConfig.RX_FIXED_LENGTH_PACKETS;
  globalConfigDoc["statementPayload"]["RX_FIXED_PAYLOAD_LENGTH"] = globalConfig.RX_FIXED_PAYLOAD_LENGTH;
  globalConfigDoc["statementPayload"]["RX_CRC_ENABLED"] = globalConfig.RX_CRC_ENABLED;
  globalConfigDoc["statementPayload"]["RX_INTRA_PACKET_FREQ_HOP_ENABLED"] = globalConfig.RX_INTRA_PACKET_FREQ_HOP_ENABLED;
  globalConfigDoc["statementPayload"]["RX_INTRA_PACKET_HOP_PERIOD"] = globalConfig.RX_INTRA_PACKET_HOP_PERIOD;
  globalConfigDoc["statementPayload"]["RX_IQ_INVERSION"] = globalConfig.RX_IQ_INVERSION;
  globalConfigDoc["statementPayload"]["RX_RECEPT_CONT"] = globalConfig.RX_RECEP_CONT;
  globalConfigDoc["statementPayload"]["RX_CS_MS"] = globalConfig.RX_CS_MS;

  Serial.println(serializeJson(globalConfigDoc, Serial));

}

//Method to parse initial Serial Json Statement (SJS) <<<<<<<<<<<<<<<<<<<<<<<<<<<<<<<<<<<<<<<<<<<<<<<<<<<<<<<<<<<<<<<<<<<<<<<<<<<<<<<<<<<<<<<<<<<<<<<<<<<<<<<<<<<<<<<<<<<<<<<<
bool ParseSJS(const String jsonStr) {
  if (DEBUG_MODE){
    ClearFreqDisplay();
  }
  // Temp doc for command entry
  StaticJsonDocument<768> doc;
  DeserializationError err = deserializeJson(doc, jsonStr);

  //If invalid SJS recieved
  if (err){
    return false;
  }

  //Get Command Type:
  String statementType = doc["statementType"] | "Unknown";
  if (statementType == "Unknown"){
    //Logic for unknown/unparsed command type
    return false;
    
    //Handle new TxMessage to send
  } else if (statementType == "TxNewMessage"){
    //Actions on new message to transmit
    String MessagePayload = doc["statementPayload"];
    //JsonObject MessagePayload = doc["statementPayload"];
    ParseTxMessage(MessagePayload);
    
    //Process the TxQueue
  } else if (statementType == "ProcessTxQueue"){
    DebugTxQueue();
    ProcessTxQueue();
    DisplayStatusSymbol("TXCOMPLETE", 2500);
    

    //Retrieve the global configuration and pass back to handler
  } else if (statementType == "GetGlobalConfig"){
    SendGlobalConfig();

    //Update the current global configuration from the handler
  } else if (statementType == "SetGlobalConfig"){
    JsonObject newGlobalConfigJson = doc["statementPayload"];
    sysGlobalConfig newGlobalConfig = ParseNewGlobalConfig(newGlobalConfigJson);
    bool globalConfigUpdateResult = UpdateGlobalConfig(newGlobalConfig);
    if (globalConfigUpdateResult){
      Serial.println("GLOBAL CONFIG UPDATE OK");
      DisplayStatusSymbol("CONFIGUPDATE", 2500);
    } else {
      Serial.println("INVALID GLOBAL CONFIG");
      DisplayStatusSymbol("CONFIGERROR", 2500);
    }

    //Begin Rx
  } else if (statementType == "RetrieveRxMessages") {
    //RetrieveAllRxMessages();
    //debugRxMessageBuffer();
    ReturnRxMessages();

  } else if (statementType == "Debug"){
    //Call custom debug functions here
    ///////////////////////////////////
    EstablishChannelState(50);

    ///////////////////////////////////

    //Else
  } else {
    return false;
  };

  //Post Command Parse Actions
  UpdateUserInterfaceElements();
  return true;
}

//Update user interface icons on display based on device configuration
void UpdateUserInterfaceElements(){
  display.resetDisplay();
  //UI Partitions
  //Icon bar
  display.drawRect(0,0, 128, 19);

  //Main display
  display.drawRect(0,21, IconLocations.FREQ_DISPLAY_X, IconLocations.FREQ_DISPLAY_Y);

  //Update Frequency
  DisplayFrequency(globalConfig.RF_FREQUENCY);

  //Draw Traffic Indicator
  display.drawXbm(IconLocations.USB_X, IconLocations.USB_Y, 16, 16, ICNUSB);
  display.drawXbm(IconLocations.TRAFF_X, IconLocations.TRAFF_Y, 16, 16, ICNMSG);

  //SF Indicator
  if (globalConfig.LORA_SPREADING_FACTOR == 5){
  display.drawXbm(IconLocations.SF_IND_X, IconLocations.SF_IND_Y, 16, 16, ICNSF5);
  } else if (globalConfig.LORA_SPREADING_FACTOR == 7){
  display.drawXbm(IconLocations.SF_IND_X, IconLocations.SF_IND_Y, 16, 16, ICNSF7);
  } else if (globalConfig.LORA_SPREADING_FACTOR == 9){
  display.drawXbm(IconLocations.SF_IND_X, IconLocations.SF_IND_Y, 16, 16, ICNSF9);
  } else if (globalConfig.LORA_SPREADING_FACTOR == 12){
  display.drawXbm(IconLocations.SF_IND_X, IconLocations.SF_IND_Y, 16, 16, ICNSF12);
  }

  //TX Power Indicator
  if (globalConfig.TX_OUTPUT_POWER < -4){
    display.drawXbm(IconLocations.TX_PWR_X, IconLocations.TX_PWR_Y, 16, 16, ICNTXPWR_ZERO);
  } else if (globalConfig.TX_OUTPUT_POWER >= -3 && globalConfig.TX_OUTPUT_POWER <= 5){
    display.drawXbm(IconLocations.TX_PWR_X, IconLocations.TX_PWR_Y, 16, 16, ICNTXPWR_LO);
  } else if (globalConfig.TX_OUTPUT_POWER > 5 && globalConfig.TX_OUTPUT_POWER <= 9){
    display.drawXbm(IconLocations.TX_PWR_X, IconLocations.TX_PWR_Y, 16, 16, ICNTXPWR_MED);
  } else if (globalConfig.TX_OUTPUT_POWER > 9 && globalConfig.TX_OUTPUT_POWER <= 13){
    display.drawXbm(IconLocations.TX_PWR_X, IconLocations.TX_PWR_Y, 16, 16, ICNTXPWR_HI);
  } else{
    display.drawXbm(IconLocations.TX_PWR_X, IconLocations.TX_PWR_Y, 16, 16, ICNTXPWR_MAX);
  }

  //Lora Status Indicator
  if (INIT_LORA_MODULE){
    InitLORA();
    display.drawXbm(111, 2, 16, 16, ICNLORA_INIT);
  } else {
    display.drawXbm(111,2, 16, 16, ICNLORA_FAIL);
  }

  //Lora TX Lockout indicator
  if (LORA_TX_LOCKOUT){
    display.drawXbm(94, 2, 16, 16, ICNTXLO);
  }
  display.drawXbm(IconLocations.DICT_IND_X, IconLocations.DICT_IND_Y, 16, 16, ICNDICT);
  display.display();
}

//Method to return a general "error" SJS over serial.
void ReturnGeneralError(String payload){
  StaticJsonDocument<256> errDoc;
  errDoc["statementType"] = "Error";
  errDoc["statementPayload"] = payload;
  Serial.println(serializeJson(errDoc, Serial));
}

//Method to return a general message SJS over serial.
void ReturnGeneralMessage(String payload){
  StaticJsonDocument<256> msgDoc;
  msgDoc["statementType"] = "Message";
  msgDoc["statemtntPayload"] = payload;
  Serial.println(serializeJson(msgDoc, Serial));
}

//Method to display a general message in the frequency display area
void DisplayStatusMessage(String message){
  ClearFreqDisplay();
  display.setFont(ArialMT_Plain_10);
  display.drawString(30, 30, message);
  display.display();
  delay(100);
}

//Main setup function
void setup() {
    //Begin serial connection
    Serial.begin(115200);
    //Init board?
    Mcu.begin(HELTEC_BOARD,SLOW_CLK_TPYE);

    //Init display
    VextON();
    display.init();
    display.clear();
    display.setTextAlignment(TEXT_ALIGN_CENTER);

    //Update display with current configuration
    UpdateUserInterfaceElements();
}

//Method to display currently tuned frequency on display, truncates raw hz to XXX.YYY+Mhz
void DisplayFrequency(int freqhz){
  float freqMhz = freqhz / 1000000.0;
  char buffer[10];
  dtostrf(freqMhz, 7, 3, buffer);
  display.setFont(ArialMT_Plain_24);
  display.drawString(45, 32, buffer);
  display.setFont(ArialMT_Plain_10);
  display.drawString(100, 44, "MHz");
}

//Initialise the LoRa module on startup
void InitLORA(){
    //Define RadioEvent Callbacks?
    RadioEvents.TxDone = OnTxDone;
    RadioEvents.TxTimeout = OnTxTimeout;
    RadioEvents.RxDone = RxDoneCallback;

    
    //Initialise Radio?
    Radio.Init( &RadioEvents );
    Radio.SetChannel( globalConfig.RF_FREQUENCY );    //Set RF Frequency
    //Configure TX Parameters
    Radio.SetTxConfig(
      MODEM_LORA,                                     //Sets modem configuration (FSK/LoRa)
      globalConfig.TX_OUTPUT_POWER,                   //Output power in dBm
      0,                                              //Frequency Deviation (FSK Only)
      globalConfig.LORA_BANDWIDTH,                    //LoRa Bandwidth (125,250,500,res)
      globalConfig.LORA_SPREADING_FACTOR,             //DataRate/SF?
      globalConfig.LORA_CODINGRATE,                   //Coderate
      globalConfig.LORA_PREAMBLE_LENGTH,              //Preamble length in symbols
      globalConfig.LORA_FIX_LENGTH_PAYLOAD_ON,        //Fixed length?
      true,                                           //CRC Enabled
      0,                                              //Frequency hopping (Intra-packet)?
      0,                                              //Hop Period
      globalConfig.LORA_IQ_INVERSION_ON,              //LoRa IQ inversion
      3000                                            //Transmission Timeout (ms)
    );

    //Configure RX Parameters
    Radio.SetRxConfig(
      MODEM_LORA,                                     //Set Modem Config
      globalConfig.LORA_BANDWIDTH,                    //LoRa Bandwidth
      globalConfig.LORA_SPREADING_FACTOR,             //SF
      globalConfig.LORA_CODINGRATE,                   //CR
      0,                                              //Bandwidth AFC
      globalConfig.LORA_PREAMBLE_LENGTH,              //Preamble length
      0,                                              //Symbol Timeout
      globalConfig.LORA_FIX_LENGTH_PAYLOAD_ON,        //Fixed length payload
      0,                                              //Fixed length payload value
      true,                                           //CRC
      0,                                              //Freq hop value
      0,                                              //Hop period
      globalConfig.LORA_IQ_INVERSION_ON,              //IQ Inversion
      true                                            //Cont Rx Mode
    );

    Radio.Standby(); 

}

//Method to enable or disable the white LED at pin 35.
void TxLED(bool state){
  if (state){
    digitalWrite(35, HIGH);
  } else {
    digitalWrite(35, LOW);
  }
}

//Enables the external power supply to OLED+LORA
void VextON(void)
{
  pinMode(35, OUTPUT);
  pinMode(Vext,OUTPUT);
  digitalWrite(Vext, LOW);
}

//Disables the external power supply to OLED+LORA
void VextOFF(void) //Vext default OFF
{
  pinMode(Vext,OUTPUT);
  digitalWrite(Vext, HIGH);
}

//Callback method when TX completed
void OnTxDone( void )
{
	DisplayUplinkArrow(false);
  TxLED(false);
}

//Callback method when TX timeout
void OnTxTimeout( void )
{
	DisplayUplinkArrow(false);
  TxLED(false);
}

//Method to enable or disable the uplink arrow, uses setpixel/clearpixel to prevent display refresh 
void DisplayUplinkArrow(bool visible){
  int TRAFF_UPL_X = IconLocations.TRAFF_UPL_X;
  int TRAFF_UPL_Y = IconLocations.TRAFF_UPL_Y;
  if (visible){
    display.setPixel(TRAFF_UPL_X, TRAFF_UPL_Y);
    display.setPixel(TRAFF_UPL_X, TRAFF_UPL_Y -4);
    display.setPixel(TRAFF_UPL_X, TRAFF_UPL_Y -3);
    display.setPixel(TRAFF_UPL_X, TRAFF_UPL_Y -2);
    display.setPixel(TRAFF_UPL_X, TRAFF_UPL_Y -1);
    display.setPixel(TRAFF_UPL_X +1, TRAFF_UPL_Y -3);
    display.setPixel(TRAFF_UPL_X +2, TRAFF_UPL_Y -2);
    display.setPixel(TRAFF_UPL_X -1, TRAFF_UPL_Y -3);
    display.setPixel(TRAFF_UPL_X -2, TRAFF_UPL_Y -2);

  } else {
    display.clearPixel(TRAFF_UPL_X, TRAFF_UPL_Y);
    display.clearPixel(TRAFF_UPL_X, TRAFF_UPL_Y -4);
    display.clearPixel(TRAFF_UPL_X, TRAFF_UPL_Y -3);
    display.clearPixel(TRAFF_UPL_X, TRAFF_UPL_Y -2);
    display.clearPixel(TRAFF_UPL_X, TRAFF_UPL_Y -1);
    display.clearPixel(TRAFF_UPL_X +1, TRAFF_UPL_Y -3);
    display.clearPixel(TRAFF_UPL_X +2, TRAFF_UPL_Y -2);
    display.clearPixel(TRAFF_UPL_X -1, TRAFF_UPL_Y -3);
    display.clearPixel(TRAFF_UPL_X -2, TRAFF_UPL_Y -2);
  }
  display.display();
}

//Method to enable or disable the downlink arrow, uses setpixel/clearpixel to prevent display refresh
void DisplayDownlinkArrow(bool visible){
  int TRAFF_DLK_X = IconLocations.TRAFF_DLK_X;
  int TRAFF_DLK_Y = IconLocations.TRAFF_DLK_Y;
  if (visible){
    display.setPixel(TRAFF_DLK_X, TRAFF_DLK_Y);
    display.setPixel(TRAFF_DLK_X -1, TRAFF_DLK_Y -1);
    display.setPixel(TRAFF_DLK_X -2, TRAFF_DLK_Y -2);
    display.setPixel(TRAFF_DLK_X +1, TRAFF_DLK_Y -1);
    display.setPixel(TRAFF_DLK_X +2, TRAFF_DLK_Y -2);
    display.setPixel(TRAFF_DLK_X, TRAFF_DLK_Y -1);
    display.setPixel(TRAFF_DLK_X, TRAFF_DLK_Y -2);
    display.setPixel(TRAFF_DLK_X, TRAFF_DLK_Y -3);
    display.setPixel(TRAFF_DLK_X, TRAFF_DLK_Y -4);
  } else {
    display.clearPixel(TRAFF_DLK_X, TRAFF_DLK_Y);
    display.clearPixel(TRAFF_DLK_X -1, TRAFF_DLK_Y -1);
    display.clearPixel(TRAFF_DLK_X -2, TRAFF_DLK_Y -2);
    display.clearPixel(TRAFF_DLK_X +1, TRAFF_DLK_Y -1);
    display.clearPixel(TRAFF_DLK_X +2, TRAFF_DLK_Y -2);
    display.clearPixel(TRAFF_DLK_X, TRAFF_DLK_Y -1);
    display.clearPixel(TRAFF_DLK_X, TRAFF_DLK_Y -2);
    display.clearPixel(TRAFF_DLK_X, TRAFF_DLK_Y -3);
    display.clearPixel(TRAFF_DLK_X, TRAFF_DLK_Y -4);
  }
  display.display();
}

//Method to clear the main frequency display section
void ClearFreqDisplay(){
  for (int x = 1; x <= (IconLocations.FREQ_DISPLAY_X - 2); x++){
    for (int y = 22; y <= (IconLocations.FREQ_DISPLAY_Y + 19); y++){
      display.clearPixel(x, y);
    }
  }
  display.display();
}

//Method to display notification symbol in main display #TODO
void DisplayStatusSymbol(String symbolType, int delayms){
  ClearFreqDisplay();
  
  if(symbolType == "CONFIGUPDATE"){
    display.drawXbm(0, 22, 126, 41, CONFIGUPDATED);
  } else if (symbolType == "CONFIGERROR"){
    display.drawXbm(0, 22, 126, 41, CONFIGERROR);
  } else if (symbolType == "TXCOMPLETE"){
    display.drawXbm(0, 22, 126, 41, TXCOMPLETE);
  } else if (symbolType == "TXINPROG"){
    display.drawXbm(0, 22, 126, 41, TXINPROG);
    return;
  } else if (symbolType == "TXLOCKOUT"){
    display.drawXbm(0,22, 126, 41, TXLOCKOUT);
  } else if (symbolType == "TXERROR"){
    display.drawXbm(0,22, 126, 41, TXERROR);
  } else if (symbolType == "TXWARMUP"){
    display.drawXbm(0,22, 126, 41, TXWARMUP);

  }


  display.display();
  delay(delayms);
  UpdateUserInterfaceElements();
  delay(100);
}

//Main functional loop
void loop() {
  if (Serial.available()){
    String input = Serial.readStringUntil('\n');
    if(ParseSJS(input)){
      //Serial.println("RJC PARSED OK");
    } else {
      ReturnGeneralError("Unrecognised SJS Command");
      UpdateUserInterfaceElements();
    }
  }
  Radio.RxBoosted(0);
  //Radio.Rx(0);
  Radio.IrqProcess();

}


